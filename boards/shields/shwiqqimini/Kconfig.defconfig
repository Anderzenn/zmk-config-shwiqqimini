## boards/shields/shwiqqimini/Kconfig.defconfig
```kconfig
if SHIELD_SHWIQQIMINI

config ZMK_KEYBOARD_NAME
    default "Shwiqqi Mini"

endif
```

## config/boards/shields/shwiqqimini/Kconfig.defconfig
```kconfig
if SHIELD_SHWIQQIMINI

config ZMK_KEYBOARD_NAME
    default "ShwiqqiMini"

endif
```
